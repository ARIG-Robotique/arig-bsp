## build/bsp-arig-nerell/conf/bblayers.conf
```bitbake
# POKY_BBLAYERS_CONF_VERSION is increased each time build/conf/bblayers.conf
# changes incompatibly
POKY_BBLAYERS_CONF_VERSION = "2"

BBPATH = "${TOPDIR}"
BBFILES ?= ""

BBLAYERS ?= " \
  ${TOPDIR}/../external-src/poky/meta \
  ${TOPDIR}/../external-src/poky/meta-poky \
  ${TOPDIR}/../external-src/poky/meta-yocto-bsp \
  ${TOPDIR}/../external-src/meta-qt5 \
  ${TOPDIR}/../external-src/meta-raspberrypi \
  ${TOPDIR}/../src/meta-arig \
  "
```

## build/src/meta-arig/conf/distro/arig.conf
```bitbake
# Poky based
require conf/distro/poky.conf

# Distro description
DISTRO = "arig"
DISTRO_NAME = "ARIG robotique distribution"
DISTRO_VERSION = "0.1"
MAINTAINER = "Gregory DEPUILLE <gregory.depuille@gmail.com>"

# Splash image to use
SPLASH = "psplash-arig"

# Add features
DISTRO_FEATURES += "wifi"

# Remove uneeded features
DISTRO_FEATURES_remove = " \
        3g \
        acl \
        alsa \
        bluetooth \
        gobject-introspection-data \
        ipv6 \
        nfc \
        nfs \
        pci \
        pcmcia \
        pulseaudio \
        usbgadget \
        vulkan \
        wayland \
        x11 \
        xattr \
        zeroconf \
"
```

## build/src/meta-arig/conf/layer.conf
```bitbake
# We have a conf and classes directory, add to BBPATH
BBPATH .= ":${LAYERDIR}"

# We have recipes-* directories, add to BBFILES
BBFILES += "${LAYERDIR}/recipes-*/*/*.bb \
            ${LAYERDIR}/recipes-*/*/*.bbappend"

BBFILE_COLLECTIONS += "meta-arig"
BBFILE_PATTERN_meta-arig = "^${LAYERDIR}/"
BBFILE_PRIORITY_meta-arig = "10"

LAYERDEPENDS_meta-arig = "core"
LAYERSERIES_COMPAT_meta-arig = "hardknott"
```

## build/src/meta-arig/conf/machine/odin.conf
```bitbake
require conf/machine/raspberrypi4-64.conf

# Raspberry Pi specific #
# --------------------- #

# Disable rainbow after gpu firmware is loaded
DISABLE_SPLASH = "1"

# Core frequency
CORE_FREQ = "500"
GPU_MEM = "128"

ENABLE_I2C = "1"
ENABLE_UART = "1"

RPI_EXTRA_CONFIG = "core_freq_min=500"

# ---------------------------------- #

hostname_pn-base-files = "odin"
```
